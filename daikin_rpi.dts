// Definitions for daikin-rpi module
/dts-v1/;
/plugin/;

/ {
        compatible = "brcm,bcm2708";

        fragment@0 {
                target-path = "/";
                __overlay__ {
                        daikin_rpi: daikin_rpi {
                                compatible = "rpi,daikin-rpi";
                                pinctrl-names = "default";
                                pinctrl-0 = <&daikin_pins>;
                                status = "okay";

                                // Override autodetection of IR receiver circuit
                                // (0 = active high, 1 = active low, -1 = no override )
                                rpi,sense = <0xffffffff>;

                                // Software carrier
                                // (0 = off, 1 = on)
                                rpi,softcarrier = <1>;

                                // Invert output
                                // (0 = off, 1 = on)
                                rpi,invert = <0>;

                                // Enable debugging messages
                                // (0 = off, 1 = on)
                                rpi,debug = <1>;
                        };
                };
        };

        fragment@1 {
                target = <&gpio>;
                __overlay__ {
                        daikin_pins: daikin_pins {
                                brcm,pins = <23 24 25 12 16 26 18>;
                                brcm,function = <1 1 1 1 1 1 0>; // out .. out in
                                brcm,pull = <0 0 0 0 0 0 0>; // off .. off
                        };
                };
        };

        __overrides__ {
                gpio_out_pin =  <&daikin_pins>,"brcm,pins:0";
                gpio_in_pin =   <&daikin_pins>,"brcm,pins:4";
                gpio_in_pull =  <&daikin_pins>,"brcm,pull:4";

                sense =         <&daikin_rpi>,"rpi,sense:0";
                softcarrier =   <&daikin_rpi>,"rpi,softcarrier:0";
                invert =        <&daikin_rpi>,"rpi,invert:0";
                debug =         <&daikin_rpi>,"rpi,debug:0";
        };
};
